## src/modules/hf30_monitor/Kconfig
```kconfig
menuconfig MODULES_HF30_MONITOR
	bool "hf30_monitor"
	default n
	---help---
		Enable HF30 monitor module
```

## src/modules/hf30_reader/Kconfig
```kconfig
menuconfig MODULES_HF30_READER
	bool "hf30_reader"
	default n
	---help---
		Enable support for hf30_reader
```

## src/systemcmds/bt_test/Kconfig
```kconfig
menuconfig SYSTEMCMDS_BT_TEST
	bool "bt_test"
	default n
	---help---
		Enable support for bt_test

menuconfig USER_BT_TEST
	bool "bt_test running as userspace module"
	default y
	depends on BOARD_PROTECTED && SYSTEMCMDS_BT_TEST
	---help---
		Put bt_test in userspace memory
```
